## conf/layer.conf
```bitbake
# We have a conf and classes directory, add to BBPATH
BBPATH .= ":${LAYERDIR}"

# We have recipes-* directories, add to BBFILES
BBFILES += "${LAYERDIR}/recipes-*/*/*.bb \
            ${LAYERDIR}/recipes-*/*/*.bbappend"

BBFILE_COLLECTIONS += "meta-ea-rauc"
BBFILE_PATTERN_meta-ea-rauc = "^${LAYERDIR}/"
BBFILE_PRIORITY_meta-ea-rauc = "6"

LAYERSERIES_COMPAT_meta-ea-rauc = "mickledore"
```
